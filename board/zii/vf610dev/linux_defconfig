## board/zii/vf610dev/linux_defconfig
```kconfig
CONFIG_NAMESPACES=y
CONFIG_BLK_DEV_INITRD=y
CONFIG_INITRAMFS_SOURCE="${BR_BINARIES_DIR}/rootfs.cpio"
CONFIG_KALLSYMS_ALL=y
CONFIG_EMBEDDED=y
CONFIG_MODULES=y
CONFIG_ARCH_MXC=y
CONFIG_SOC_VF610=y
CONFIG_AEABI=y
CONFIG_NET=y
CONFIG_PACKET=y
CONFIG_UNIX=y
CONFIG_INET=y
# CONFIG_IPV6 is not set
CONFIG_NETFILTER=y
CONFIG_NETFILTER_DEBUG=y
CONFIG_BRIDGE_NETFILTER=y
CONFIG_BRIDGE=y
CONFIG_BRIDGE_VLAN_FILTERING=y
CONFIG_NET_DSA=y
CONFIG_VLAN_8021Q=y
CONFIG_NET_SWITCHDEV=y
CONFIG_DEVTMPFS=y
CONFIG_DEVTMPFS_MOUNT=y
CONFIG_MTD=y
CONFIG_MTD_M25P80=y
CONFIG_MTD_SPI_NOR=y
CONFIG_DS1682=y
CONFIG_EEPROM_AT24=y
CONFIG_EEPROM_93XX46=y
CONFIG_NETDEVICES=y
CONFIG_NET_DSA_MV88E6XXX=y
CONFIG_MDIO_BUS_MUX_GPIO=y
CONFIG_SERIAL_FSL_LPUART=y
CONFIG_SERIAL_FSL_LPUART_CONSOLE=y
CONFIG_HW_RANDOM=y
CONFIG_I2C=y
CONFIG_I2C_MUX=y
CONFIG_I2C_MUX_PCA954x=y
CONFIG_I2C_IMX=m
CONFIG_SPI=y
CONFIG_SPI_FSL_DSPI=y
CONFIG_GPIO_PCA953X=y
CONFIG_GPIO_PCA953X_IRQ=y
CONFIG_SENSORS_ADT7411=y
CONFIG_SENSORS_LM75=y
CONFIG_WATCHDOG=y
CONFIG_IMX2_WDT=y
CONFIG_MFD_SYSCON=y
# CONFIG_HID is not set
CONFIG_MMC=y
CONFIG_MMC_SDHCI=y
CONFIG_MMC_SDHCI_PLTFM=y
CONFIG_MMC_SDHCI_ESDHC_IMX=y
CONFIG_NEW_LEDS=y
CONFIG_LEDS_CLASS=y
CONFIG_LEDS_GPIO=y
CONFIG_DMADEVICES=y
CONFIG_FSL_EDMA=y
CONFIG_IIO=y
CONFIG_VF610_ADC=y
CONFIG_PWM=y
CONFIG_PWM_FSL_FTM=y
CONFIG_EXT4_FS=y
CONFIG_VFAT_FS=y
CONFIG_TMPFS=y
CONFIG_DYNAMIC_DEBUG=y
CONFIG_DEBUG_FS=y
# CONFIG_FTRACE is not set
CONFIG_DEBUG_LL=y
CONFIG_DEBUG_VF_UART_PORT=0
CONFIG_CRYPTO_ECHAINIV=y
```

## configs/zii_vf610dev_defconfig
```kconfig
BR2_arm=y
BR2_cortex_a5=y
BR2_TARGET_GENERIC_HOSTNAME="vf610dev"
BR2_TARGET_GENERIC_ISSUE="Welcome to ZII VF610 Development Board"
BR2_ROOTFS_POST_IMAGE_SCRIPT="board/zii/vf610dev/post-image.sh"
BR2_LINUX_KERNEL=y
BR2_LINUX_KERNEL_USE_CUSTOM_CONFIG=y
BR2_LINUX_KERNEL_CUSTOM_CONFIG_FILE="board/zii/vf610dev/linux_defconfig"
BR2_LINUX_KERNEL_UIMAGE=y
BR2_LINUX_KERNEL_UIMAGE_LOADADDR="0x80008000"
BR2_LINUX_KERNEL_DTS_SUPPORT=y
BR2_LINUX_KERNEL_INTREE_DTS_NAME="vf610-zii-dev-rev-b"
BR2_TARGET_ROOTFS_EXT2=y
BR2_TARGET_ROOTFS_EXT2_4=y
BR2_TARGET_UBOOT=y
BR2_TARGET_UBOOT_BOARDNAME="zii-vf610-dev-rev-b"
BR2_TARGET_UBOOT_CUSTOM_GIT=y
BR2_TARGET_UBOOT_CUSTOM_REPO_URL="https://bitbucket.org/pid1solutions/zodiac-vybrid-uboot.git"
BR2_TARGET_UBOOT_CUSTOM_REPO_VERSION="ctt-fec"
BR2_TARGET_UBOOT_FORMAT_IMX=y
BR2_TARGET_UBOOT_ENVIMAGE=y
BR2_TARGET_UBOOT_ENVIMAGE_SOURCE="board/zii/vf610dev/u-boot-env.txt"
BR2_TARGET_UBOOT_ENVIMAGE_SIZE="0x2000"
BR2_PACKAGE_HOST_GENIMAGE=y
```

## package/mstpd/Config.in
```kconfig
config BR2_PACKAGE_MSTPD
	bool "mstpd"
	help
	  Multiple Spanning Tree Protocol daemon.
	  msptd implements the IEEE 802.1s Multiple Spanning Tree Protocol.

	  https://sourceforge.net/projects/mstpd/
```
